## arch/arm/mach-nuc980/Kconfig
```kconfig
if ARCH_NUC980

config CPU_NUC980
	bool
	select HAVE_CLK_PREPARE
	select HAVE_MACH_CLKDEV
	select COMMON_CLK
	default y
	help
	  Support of Nuvoton NUC980 MPU

menu "NUC980 Machines"

config MACH_NUC980
	bool "Nuvoton NUC980 Evaluation Board"
	default y
	select CPU_NUC980
	help
	   Say Y here if you are using the Nuvoton NUC980
endmenu

choice
	prompt "Nuvoton NUC980 Series Development Board"

config BOARD_NUC980
	depends on !USE_OF
	bool "NUC980 Development Board"

config BOARD_ETH2UART
	depends on !USE_OF
	bool "NUC980 ETHERNET To UART Board"

config BOARD_IOT
	depends on !USE_OF
	bool "NUC980 IoT Board"

config BOARD_USB8P
	depends on !USE_OF
	bool "NUC980 8 Port USB Board"
endchoice

config NUC980_FIQ
	bool "Nuvoton NUC980 FIQ support"
	select FIQ
	help
	   Support FIQ in NUC980. For more information, please refer to NUC980 BSP user's manual.

endif
```

## drivers/media/i2c/nuvoton/Kconfig
```kconfig
config VIDEO0_NUC980
	tristate "Nuvoton NUC980 Video-In0 Support"
	depends on I2C && VIDEO_DEV
	select VIDEO_BUF
	select VIDEOBUF_DMA_CONTIG
	---help---
	Support for built-in video-in interface for NUC980.
config VIN0_MAX_FRAME_BUFFER
	int "Max frame buffer"
	depends on VIDEO0_NUC980
	default "3"
config VIDEO0_FREQ
	int "Video frequency"
	depends on VIDEO0_NUC980
	default "24000000"
if !USE_OF
choice
	prompt "Nuvoton NUC980 Image Sensor Selection"
	depends on VIDEO0_NUC980
	default SENSOR0_NT99141
config SENSOR0_OV7725
	bool "OV7725"
config SENSOR0_OV5640
	bool "OV5640"
config SENSOR0_NT99141
	bool "NT99141"
config SENSOR0_NT99050
	bool "NT99050"
config SENSOR0_TW9912
	bool "TW9912"
config SENSOR0_GC0308
        bool "GC0308"
endchoice
endif


config VIDEO1_NUC980
        tristate "Nuvoton NUC980 Video-In1 Support"
        depends on I2C && VIDEO_DEV
        select VIDEO_BUF
        select VIDEOBUF_DMA_CONTIG
        ---help---
        Support for built-in video-in interface for NUC980.
config VIN1_MAX_FRAME_BUFFER
        int "Max frame buffer"
        depends on VIDEO1_NUC980
        default "3"
config VIDEO1_FREQ
        int "Video frequency"
        depends on VIDEO1_NUC980
	default "24000000"
if !USE_OF
choice
        prompt "Nuvoton NUC980 Image Sensor Selection"
        depends on VIDEO1_NUC980
        default SENSOR1_NT99141
config SENSOR1_OV7725
        bool "OV7725"
config SENSOR1_OV5640
        bool "OV5640"
config SENSOR1_NT99141
        bool "NT99141"
config SENSOR1_NT99050
        bool "NT99050"
config SENSOR1_TW9912
        bool "TW9912"
config SENSOR1_GC0308
        bool "GC0308"
endchoice

endif
```

## drivers/net/can/nuc980_can/Kconfig
```kconfig
menuconfig NUC980_CAN
	tristate "NUC980 CAN0~CAN3 devices"
	depends on HAS_IOMEM

if NUC980_CAN

config NUC980_CAN0
	bool "NUC980 CAN0 support"
	help
	  This selects NUC980 CAN0 driver

config ENABLE_CAN0_RX_WAKEUP
	bool "Enable CAN0 wake-up function"
	depends on NUC980_CAN0
	help
	  This selects NUC980 CAN0 wake-up function

choice
	prompt "NUC980 CAN0 pin selection"
	default NUC980_CAN0_PC
	depends on NUC980_CAN0
	help
	  Select CAN0 multi-function pin.

	config NUC980_CAN0_PC
		bool "Rx:PC3, Tx:PC4"
	config NUC980_CAN0_PD
		bool "Rx:PD6, Tx:PD7"
	config NUC980_CAN0_PG
		bool "Rx:PG11, Tx:PG12"
	config NUC980_CAN0_PE
		bool "Rx:PE0, Tx:PE1"
endchoice

config NUC980_CAN1
	bool "NUC980 CAN1 support"
	help
	  This selects NUC980 CAN1 driver

config ENABLE_CAN1_RX_WAKEUP
	bool "Enable CAN1 wake-up function"
	depends on NUC980_CAN1
	help
	  This selects NUC980 CAN1 wake-up function

choice
	prompt "NUC980 CAN1 pin selection"
	default NUC980_CAN1_PA
	depends on NUC980_CAN1
	help
	  Select CAN1 multi-function pin.

	config NUC980_CAN1_PA
		bool "Rx:PA13, Tx:PA14"
	config NUC980_CAN1_PD
		bool "Rx:PD14, Tx:PD15"
	config NUC980_CAN1_PG
		bool "Rx:PG13, Tx:PG14"
	config NUC980_CAN1_PE
		bool "Rx:PE2, Tx:PE3"
endchoice

config NUC980_CAN2
	bool "NUC980 CAN2 support"
	help
	  This selects NUC980 CAN2 driver

config ENABLE_CAN2_RX_WAKEUP
	bool "Enable CAN2 wake-up function"
	depends on NUC980_CAN2
	help
	  This selects NUC980 CAN2 wake-up function

choice
	prompt "NUC980 CAN2 pin selection"
	default NUC980_CAN2_PA
	depends on NUC980_CAN2
	help
	  Select CAN2 multi-function pin.

	config NUC980_CAN2_PA
		bool "Rx:PA15, Tx:PG10"
	config NUC980_CAN2_PB
		bool "Rx:PB1, Tx:PB3"
	config NUC980_CAN2_PB_PC
		bool "Rx:PB8, Tx:PC0"
	config NUC980_CAN2_PD
		bool "Rx:PD12, Tx:PD13"
	config NUC980_CAN2_PE
		bool "Rx:PE4, Tx:PE5"
endchoice

config NUC980_CAN3
	bool "NUC980 CAN3 support"
	help
	  This selects NUC980 CAN3 driver

config ENABLE_CAN3_RX_WAKEUP
	bool "Enable CAN3 wake-up function"
	depends on NUC980_CAN3
	help
	  This selects NUC980 CAN3 wake-up function

choice
	prompt "NUC980 CAN3 pin selection"
	default NUC980_CAN3_PA
	depends on NUC980_CAN3
	help
	  Select CAN3 multi-function pin.

	config NUC980_CAN3_PA
		bool "Rx:PA0, Tx:PA1"
	config NUC980_CAN3_PE_0
		bool "Rx:PE6, Tx:PE7"
	config NUC980_CAN3_PE_1
		bool "Rx:PE10, Tx:PE12"
endchoice

endif
```

## drivers/staging/mt29f_spinand/Kconfig
```kconfig
config MTD_SPINAND_MT29F
	tristate "SPINAND Device Support"
	depends on MTD_NAND && SPI
	help
	  This enables support for accessing SPI NAND flash
	  devices.
	  If you have SPI NAND chip say yes.

	  If unsure, say no here.

config MTD_SPINAND_ONDIEECC
	bool
	default y if MTD_SPINAND_MT29F

config MTD_SPINAND_GIGADEVICE
	bool
	default y if MTD_SPINAND_MT29F

config WINBOND_W25N_KV_KW_JV_JW
	tristate "Winbond W25N KV/KW/JV/JW SPI NAND Support"
	depends on MTD_SPINAND_MT29F
	help
	  This enables support for W25N KV/KW/JV/JW SPI NAND flash.
	  For instance, Winbond W25N02KV SPI NAND flash.

config WINBOND_MULTIDIE
	tristate "Winbond Multi-Die SPI NAND Support"
	depends on MTD_SPINAND_MT29F
	help
	  This enables support for Winbond multi-die SPI NAND flash.
	  For instance, Winbond W25N02GV SPI NAND flash.
```

## sound/soc/nuc980/Kconfig
```kconfig
##
## NUC980 series I2S API
##
config SND_SOC_NUC980
	tristate "SoC Audio for NUC980 series"
	depends on ARCH_NUC980
	help
	  This option enables support for I2S on the NUC980 SoC.

##
## Boards
##
config SND_SOC_NUC980EVB
	tristate "NUC980 I2S support for demo board"
	depends on SND_SOC_NUC980
	select SND_SOC_NAU8822
	help
	  Select this option to enable audio (I2S) on the
	  NUC980 demoboard.

choice
	prompt "I2S Mode Selection"
	depends on SND_SOC_NUC980EVB
	default SLAVE_MODE

config NUC980_I2S_MASTER_MODE
	bool "Master Mode"

config NUC980_I2S_SLAVE_MODE
	bool "Slave Mode"

endchoice

choice
	prompt "NUC980 I2S pin selection"
	default NUC980_I2S_PA
	depends on SND_SOC_NUC980EVB

config NUC980_I2S_PA
	bool "Port A"
config NUC980_I2S_PB
	bool "Port B"
endchoice
```
